## target/configs/d21x_demo88-mmc_baremetal_bootloader_defconfig
```kconfig
CONFIG_PRJ_DEFCONFIG_FILENAME="d21x_demo88-mmc_baremetal_bootloader_defconfig"
CONFIG_PRJ_CHIP="d21x"
CONFIG_PRJ_BOARD="demo88-mmc"
CONFIG_PRJ_KERNEL="baremetal"
CONFIG_PRJ_APP="bootloader"
CONFIG_PRJ_CUSTOM_LDS="application/baremetal/bootloader/ldscript/d21x_bootloader_gcc.ld"
CONFIG_AIC_USING_UART0=y
# CONFIG_AIC_USING_USB1 is not set
CONFIG_AIC_USING_SDMC0=y
CONFIG_AIC_SDMC0_CLK_FREQ=35000000
CONFIG_AIC_WIRELESS_LAN=y
CONFIG_AIC_DISP_LVDS=y
CONFIG_AIC_LVDS_LINK_0=y
CONFIG_AICFB_RGB565=y
# CONFIG_AIC_DISP_BOOTUP_LOGO is not set
CONFIG_AIC_PANEL_CUSTOM_RESOLUTION=y
CONFIG_PANEL_PIXELCLOCK=65
CONFIG_PANEL_VACTIVE=768
CONFIG_AIC_PANEL_ENABLE_GPIO="PE.18"
# CONFIG_AIC_USING_GE is not set
# CONFIG_AIC_USING_VE is not set
CONFIG_AIC_USING_DMA=y
CONFIG_AIC_USING_WRI=y
CONFIG_AIC_USING_RTC=y
CONFIG_AIC_USING_WDT=y
CONFIG_AIC_DRAM_TOTAL_SIZE=0x4000000
CONFIG_AIC_INTERRUPTSTACK_SIZE=8192
CONFIG_AIC_NORMALSTACK_SIZE=8192
CONFIG_AIC_BOOTLOADER_TEXT_SIZE=0x7FF00
CONFIG_AIC_BOOTLOADER_HEAP_SIZE=0x280000
CONFIG_AIC_BOOTLOADER_MMC_SUPPORT=y
# CONFIG_AIC_BOOTLOADER_SPINOR_SUPPORT is not set
# CONFIG_AIC_BOOTLOADER_SPINAND_SUPPORT is not set
CONFIG_AICUPG_UDISK_ENABLE=y
CONFIG_AICUPG_MMC_ARTINCHIP=y
CONFIG_AIC_BOOTLOADER_CMD_MMC_BOOT=y
CONFIG_AIC_BOOTLOADER_CMD_PART=y
CONFIG_AIC_BOOTLOADER_CMD_PROGRESS_BAR=y
CONFIG_AIC_BOOTLOADER_CMD_FB_CONSOLE=y
CONFIG_AICUPG_DEBUG=y
CONFIG_AICUPG_UART_DEBUG=y
CONFIG_AIC_SHOW_BOOT_TIME=y
CONFIG_LPKG_CHERRYUSB_DEVICE_CLASS_AIC_SINGLE=y
# CONFIG_LPKG_MPP is not set
CONFIG_AIC_ENV_INTERFACE=y
CONFIG_LPKG_USING_SPINAND=y
CONFIG_AIC_MMC_BARE_TEST=y
```
